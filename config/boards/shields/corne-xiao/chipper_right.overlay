/*
 * Copyright (c) 2020 Pete Johanson
 *
 * SPDX-License-Identifier: MIT
 */

#include "chipper.dtsi"

&default_transform {
	col-offset = <6>;
};

&five_column_transform {
	col-offset = <6>;
};

&kscan0 {
	col-gpios
		= <&gpio1 11 GPIO_ACTIVE_HIGH>	//Col0
		, <&gpio1 12 GPIO_ACTIVE_HIGH>  //Col1
		, <&gpio1 13 GPIO_ACTIVE_HIGH>  //Col2
		, <&gpio1 14 GPIO_ACTIVE_HIGH>  //Col3
		, <&gpio1 15 GPIO_ACTIVE_HIGH>  //Col4
		, <&gpio0 10 GPIO_ACTIVE_HIGH>  //Col5
		;
};

#define MOUSE_PS2_DRIVER_UART
#define MOUSE_PS2_PIN_SCL_PINCTRL <NRF_PSEL(SPIM_SCK, 0, 5)>,
#define MOUSE_PS2_PIN_SDA_PINCTRL <NRF_PSEL(SPIM_MOSI, 0, 4)>,
#define MOUSE_PS2_PIN_RST_PRO_MICRO <&gpio0 9 GPIO_ACTIVE_HIGH>;
