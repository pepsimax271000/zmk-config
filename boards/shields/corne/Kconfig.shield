## boards/shields/corne/Kconfig.shield
```kconfig
# No whitespace after the comma or in the keyboard name!
config SHIELD_CORNE
    def_bool $(shields_list_contains,corne_dongle)
```

## boards/shields/roBa/Kconfig.defconfig
```kconfig
if SHIELD_ROBA_DONGLE

config ZMK_KEYBOARD_NAME
  default "roBa"

config ZMK_SPLIT_BLE_ROLE_CENTRAL
  default y    

config ZMK_POINTING
  default y

endif

if SHIELD_ROBA_DONGLE || SHIELD_ROBA_L || SHIELD_ROBA_R

config ZMK_SPLIT
  default y

endif

if SHIELD_ROBA_R

config SPI
  default y

endif
```

## config/boards/shields/evo44/Kconfig.defconfig
```kconfig
if SHIELD_EVO44_LEFT

config ZMK_KEYBOARD_NAME
    default "evo44"

config ZMK_SPLIT_ROLE_CENTRAL
    default y
endif

if SHIELD_EVO44_LEFT || SHIELD_EVO44_RIGHT

config ZMK_SPLIT
    default y

endif
```

## config/boards/shields/evo44/Kconfig.shield
```kconfig
config SHIELD_EVO44_LEFT
    def_bool $(shields_list_contains,evo44_left)

config SHIELD_EVO44_RIGHT
    def_bool $(shields_list_contains,evo44_right)
```

## config/boards/shields/evo56/Kconfig.defconfig
```kconfig
if SHIELD_EVO56_LEFT

config ZMK_KEYBOARD_NAME
    default "evo56"

config ZMK_SPLIT_ROLE_CENTRAL
    default y
endif

if SHIELD_EVO56_LEFT || SHIELD_EVO56_RIGHT

config ZMK_SPLIT
    default y

endif
```

## config/boards/shields/evo56/Kconfig.shield
```kconfig
config SHIELD_EVO56_LEFT
    def_bool $(shields_list_contains,evo56_left)

config SHIELD_EVO56_RIGHT
    def_bool $(shields_list_contains,evo56_right)
```

## config/boards/shields/petruiza/Kconfig.defconfig
```kconfig
# Copyright (c) 2023 The ZMK Contributors
# SPDX-License-Identifier: MIT

if SHIELD_PETRUIZA

config ZMK_KEYBOARD_NAME
    default "PETRUIZA"

endif
```

## config/west.yml
```yaml
manifest:
  remotes:
    - name: urob
      url-base: https://github.com/urob

    - name: zmkfirmware
      url-base: https://github.com/zmkfirmware

    - name: carrefinho
      url-base: https://github.com/carrefinho

    - name: m165437
      url-base: https://github.com/m165437

    - name: badjeff
      url-base: https://github.com/badjeff

  projects:
    - name: zmk
      remote: zmkfirmware
      import: app/west.yml
      revision: main

    - name: zmk-adaptive-key
      remote: urob
      path: modules/zmk-adaptive-key
      revision: main
    - name: zmk-auto-layer
      remote: urob
      path: modules/zmk-auto-layer
      revision: main
    - name: zmk-helpers
      remote: urob
      path: modules/zmk-helpers
      revision: main
    - name: zmk-leader-key
      remote: urob
      path: modules/zmk-leader-key
      revision: main
    - name: zmk-tri-state
      remote: urob
      path: modules/zmk-tri-state
      revision: main
    - name: zmk-unicode
      remote: urob
      path: modules/zmk-unicode
      revision: main

    - name: prospector-zmk-module
      remote: carrefinho
      revision: feat/new-status-screens

    - name: nice-view-gem
      remote: m165437
      revision: main

    - name: zmk-pmw3610-driver
      remote: badjeff
      revision: main

  self:
    path: config
```
